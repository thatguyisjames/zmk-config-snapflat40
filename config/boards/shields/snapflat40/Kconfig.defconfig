## config/boards/shields/snapflat40/Kconfig.defconfig
```kconfig
if SHIELD_SNAPFLATFOURTY

config ZMK_KEYBOARD_NAME
    default "snapflatfourty"

endif
```

## config/boards/shields/snapflat40/Kconfig.shield
```kconfig
config SHIELD_SNAPFLATFOURTY
    def_bool $(shields_list_contains,snapflatfourty)
```
